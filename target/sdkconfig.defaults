## target/sdkconfig.defaults
```kconfig
CONFIG_PARTITION_TABLE_SINGLE_APP_LARGE=y
CONFIG_NEWLIB_NANO_FORMAT=y
CONFIG_COMPILER_OPTIMIZATION_LEVEL_RELEASE=y
CONFIG_OPTIMIZATION_LEVEL_RELEASE=y
CONFIG_COMPILER_OPTIMIZATION_SIZE=y
CONFIG_ESP_TASK_WDT=n
CONFIG_FREERTOS_GENERATE_RUN_TIME_STATS=y
```

## target_old/tflm/sdkconfig.defaults
```kconfig
# Copyright 2020 The TensorFlow Authors. All Rights Reserved.
#
# Licensed under the Apache License, Version 2.0 (the "License");
# you may not use this file except in compliance with the License.
# You may obtain a copy of the License at
#
#     http://www.apache.org/licenses/LICENSE-2.0
#
# Unless required by applicable law or agreed to in writing, software
# distributed under the License is distributed on an "AS IS" BASIS,
# WITHOUT WARRANTIES OR CONDITIONS OF ANY KIND, either express or implied.
# See the License for the specific language governing permissions and
# limitations under the License.

CONFIG_FREERTOS_HZ=100

# THE NEW CHIPS HAVE 2MB OF FLASH
# Prevent warning on a mismatch in flash size when flashing. Default is 2MB; we
# have a chip with 4MB of flash.
# CONFIG_ESPTOOLPY_FLASHSIZE_2MB=y
# CONFIG_ESPTOOLPY_FLASHFREQ_80M=y

CONFIG_FLASHMODE_QIO=y

# CONFIG_ESP32C3_DEFAULT_CPU_FREQ_160=y
# CONFIG_ESP32C3_DEFAULT_CPU_FREQ_MHZ=160

CONFIG_INT_WDT=
CONFIG_ESP_INT_WDT=n
CONFIG_TASK_WDT=
CONFIG_ESP_TASK_WDT=n

CONFIG_COMPILER_OPTIMIZATION_PERF=y
#CONFIG_COMPILER_OPTIMIZATION_SIZE=y

#CONFIG_FREERTOS_GENERATE_RUN_TIME_STATS=y
```
